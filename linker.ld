/* =======================================================================
 * linker.ld - 内核链接脚本
 * 
 * 这个脚本告诉 GNU ld（链接器）如何将编译后的目标文件组装成最终的
 * 内核二进制。i386 架构的裸机内核不能依赖操作系统的加载器，所以需要
 * 手动指定每个段的加载地址和排列顺序。
 * 
 * 关键设计点：
 *   1. 将入口点设为 _start（在 start.asm 中定义），链接器会把这个
 *      地址写入 ELF 头的 e_entry 字段，GRUB 等引导器加载后会跳转至此。
 *   2. 从 1MB（0x100000）开始加载——这是 x86 传统约定，0~1MB 范围
 *      保留给 BIOS、VGA 显存和实模式数据，内核放在 1MB 以上最安全。
 *   3. 按 .multiboot → .text → .data → .rodata → .bss 的顺序排列，
 *      确保 Multiboot 头部在文件最前面（GRUB 要求）。
 *   4. 在 BSS 段末尾定义 _end 符号，物理内存管理器（PMM）用它确定
 *      内核占用的结束位置，避免分配已被内核使用的物理页。
 * ======================================================================= */

/* 入口点：_start（定义在 start/start.asm） */
ENTRY(_start)

SECTIONS
{
    /* 内核基址 = 1MB（0x100000） */
    . = 1M;

    /* ---- Multiboot 头 ---- */
    /* 必须放在文件开头 8KB 以内，GRUB 通过扫描这里找到启动信息 */
    .multiboot ALIGN(4) : { *(.multiboot) }

    /* ---- 代码段 ---- */
    /* 可执行指令，只读。ALIGN(4) 保证 4 字节对齐（i386 指令对齐要求） */
    .text ALIGN(4) : { *(.text) }

    /* ---- 数据段 ---- */
    /* 已初始化的全局变量和静态变量，可读写 */
    .data ALIGN(4) : { *(.data) }

    /* ---- 只读数据段 ---- */
    /* 字符串常量、const 变量、跳转表等，运行期间不会修改 */
    .rodata ALIGN(4) : { *(.rodata) }

    /* ---- BSS 段 ---- */
    /* 未初始化的全局变量（或初始化为 0 的），在 ELF 中不占文件空间，
     * 但加载器需要为其分配内存并清零。内核自身在 pmm_init 中手动清零 */
    .bss ALIGN(4) : { *(.bss) }

    /* ---- 内核结束 ---- */
    /* 对齐到页边界（4096 字节），这样 _end 可以直接用于 PMM 位图起始 */
    . = ALIGN(4096);
    _end = .;
}
